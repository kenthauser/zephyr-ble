## tests/bluetooth/shell/Kconfig
```kconfig
# Copyright (c) 2026 Nordic Semiconductor ASA
# SPDX-License-Identifier: Apache-2.0

mainmenu "Bluetooth Shell Test Application"

# LE Audio Controller settings for non-network core devices
if BT_AUDIO && BT_LL_SW_SPLIT

configdefault BT_CTLR_DATA_LENGTH_MAX
	default 251

# Set to high value to support large BASEs + extra data
configdefault BT_CTLR_SCAN_DATA_LEN_MAX
	default 1650

configdefault BT_CTLR_ADV_SYNC_SET
	default BT_CTLR_ADV_AUX_SET

configdefault BT_CTLR_ADV_DATA_LEN_MAX
	default 191

configdefault BT_CTLR_ADV_DATA_BUF_MAX
	default 6

# Match BT_BAP_BROADCAST_SRC_STREAM_COUNT in audio.conf
configdefault BT_CTLR_SYNC_ISO_STREAM_MAX
	default 2

# Match BT_BAP_BROADCAST_SNK_STREAM_COUNT in audio.conf
configdefault BT_CTLR_ADV_ISO_STREAM_MAX
	default 2

# Match BT_BAP_UNICAST_CLIENT_ASE_SRC_COUNT/BT_ASCS_MAX_ASE_SNK_COUNT audio.conf
configdefault BT_CTLR_ISOAL_SOURCES
	default 2

# BT_BAP_UNICAST_CLIENT_ASE_SNK_COUNT/BT_ASCS_MAX_ASE_SRC_COUNT in audio.conf
configdefault BT_CTLR_ISOAL_SINKS
	default 2

endif # BT_AUDIO && BT_LL_SW_SPLIT

config APP_AESX
	bool "aesx: application AES-CCM, AES engine contention test"
	depends on BT_GATT_CLIENT
	select CRYPTO
	select CRYPTO_MBEDTLS_SHIM if !DT_HAS_TI_CC23X0_AES_ENABLED
	help
	  The aesx shell command: the sender AES-CCM encrypts each GATT write,
	  the receiver decrypts and verifies it. Where the controller encrypts
	  the link on the same AES engine, this tests contention for the engine.
	  AES goes through the Zephyr crypto API: crypto_cc23x0 where present,
	  else the Mbed TLS shim. src/aesx.c.

if APP_AESX

# Three sessions: the sender/receiver's encrypt and decrypt, and the background load's.
configdefault CRYPTO_MBEDTLS_SHIM_MAX_SESSION
	default 3

config APP_AESX_BG_LEN
	int "aesx background load: bytes per CCM op"
	default 512

config APP_AESX_BG_STACK
	int "aesx background load: thread stack size"
	default 1024

endif # APP_AESX

source "Kconfig.zephyr"
```
